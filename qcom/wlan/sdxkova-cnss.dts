/dts-v1/;
/plugin/;

#include "sdxkova-cnss.dtsi"

/ {
	model = "Qualcomm Technologies, Inc. SDXKOVA SoC";
	compatible = "qcom,sdxkova";
	qcom,msm-id = <677 0x10000>, <678 0x10000>, <679 0x10000>;
	qcom,board-id = <0x10022 0x300>, <0x10022 0x400>, <0x30022 0x300>, <0x30022 0x400>, <0x10015 0x300>, <0x30015 0x300>, <0x30015 0x400>;
};
