/dts-v1/;
/plugin/;

#include "volcano-audio-cdp-wcn6450.dtsi"

/ {
	model = "Qualcomm Technologies, Inc. Volcano IDP + Evros";
	compatible = "qcom,volcano-idp", "qcom,volcano", "qcom,volcanop-idp", "qcom,volcanop", "qcom,idp";
	qcom,msm-id = <636 0x10000>, <640 0x10000>, <641 0x10000>, <712 0x10000>;
	qcom,board-id = <34 4>;
};
