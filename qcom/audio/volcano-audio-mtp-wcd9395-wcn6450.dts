/dts-v1/;
/plugin/;

#include "volcano-audio-mtp-wcd9395-wcn6450.dtsi"

/ {
	model = "Qualcomm Technologies, Inc. Volcano MTP + WCD9395 AATC + SN220T + Evros";
	compatible = "qcom,volcano-mtp", "qcom,volcano", "qcom,volcanop-mtp", "qcom,volcanop", "qcom,mtp";
	qcom,msm-id = <636 0x10000>, <640 0x10000>, <641 0x10000>, <712 0x10000>;
	qcom,board-id = <8 9>;
};
